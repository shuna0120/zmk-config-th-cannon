## boards/shields/Cannonball_LL/Kconfig.defconfig
```kconfig
if CANNONBALL_LL

    config ZMK_KEYBOARD_NAME
        default "Cannonball LL"

    config ZMK_POINTING
        default y

    config SPI
        default y

    config PMW3610_ALT
        default y

    config INPUT
        default y

    config EC11
        default y

endif
```

## config/west.yml
```yaml
manifest:
  remotes:
    - name: zmkfirmware
      url-base: https://github.com/zmkfirmware
    - name: badjeff
      url-base: https://github.com/badjeff
    - name: caksoylar
      url-base: https://github.com/caksoylar
  projects:
    - name: zmk
      remote: zmkfirmware
      revision: v0.2.1
      import: app/west.yml
    - name: zmk-pmw3610-driver
      remote: badjeff
      revision: main
    - name: zmk-rgbled-widget
      remote: caksoylar
      # ZMK v0.2.1 で動く最後の版（2026-02-17 以降の main は v0.3 専用）
      revision: e9472d6c59b8e901753dfa6c337c1b24cb70f571
  self:
    path: config
```
